## colibri/configs/toradex_defconfig
```kconfig
BR2_arm=y
BR2_cortex_a7=y
BR2_ARM_FPU_NEON_VFPV4=y
BR2_CCACHE=y
BR2_GLOBAL_PATCH_DIR="$(BR2_EXTERNAL_TORADEX_PATH)/patches"
BR2_TOOLCHAIN_EXTERNAL=y
BR2_TOOLCHAIN_EXTERNAL_LINARO_ARM=y
BR2_TARGET_GENERIC_HOSTNAME="mydevice"
BR2_TARGET_GENERIC_ISSUE="Welcome to My Device"
BR2_ROOTFS_DEVICE_CREATION_DYNAMIC_MDEV=y
# BR2_TARGET_GENERIC_REMOUNT_ROOTFS_RW is not set
BR2_ROOTFS_USERS_TABLES="$(BR2_EXTERNAL_TORADEX_PATH)/users.txt"
BR2_ROOTFS_OVERLAY="$(BR2_EXTERNAL_TORADEX_PATH)/overlay"
BR2_ROOTFS_POST_BUILD_SCRIPT="$(BR2_EXTERNAL_TORADEX_PATH)/post_build.sh"
BR2_ROOTFS_POST_IMAGE_SCRIPT="$(BR2_EXTERNAL_TORADEX_PATH)/post_image.sh"
BR2_LINUX_KERNEL=y
BR2_LINUX_KERNEL_DEFCONFIG="imx_v6_v7"
BR2_LINUX_KERNEL_CONFIG_FRAGMENT_FILES="$(BR2_EXTERNAL_TORADEX_PATH)/board/colibri-imx7/linux.configfrag"
BR2_LINUX_KERNEL_DTS_SUPPORT=y
BR2_LINUX_KERNEL_INTREE_DTS_NAME="imx7d-colibri-eval-v3"
BR2_LINUX_KERNEL_INSTALL_TARGET=y
BR2_PACKAGE_LINUX_TOOLS_GPIO=y
BR2_PACKAGE_BUSYBOX_CONFIG_FRAGMENT_FILES="$(BR2_EXTERNAL_TORADEX_PATH)/configs/busybox.configfrag"
BR2_PACKAGE_BUSYBOX_SHOW_OTHERS=y
BR2_PACKAGE_GIT=y
BR2_PACKAGE_MTD=y
BR2_PACKAGE_UBOOT_TOOLS=y
BR2_PACKAGE_AUDIOFILE=y
BR2_PACKAGE_LIBCUEFILE=y
BR2_PACKAGE_LIBID3TAG=y
BR2_PACKAGE_LIBMAD=y
BR2_PACKAGE_LIBMPDCLIENT=y
BR2_PACKAGE_LIBREPLAYGAIN=y
BR2_PACKAGE_LIBSAMPLERATE=y
BR2_PACKAGE_LIBSNDFILE=y
BR2_PACKAGE_LIBSOXR=y
BR2_PACKAGE_OPUS=y
BR2_PACKAGE_CA_CERTIFICATES=y
BR2_PACKAGE_LIBGPIOD=y
BR2_PACKAGE_LIBGPIOD_TOOLS=y
BR2_PACKAGE_JSONCPP=y
BR2_PACKAGE_LIBMICROHTTPD=y
BR2_PACKAGE_LIBUPNPP=y
BR2_PACKAGE_BOOST=y
BR2_PACKAGE_GLIBMM=y
BR2_PACKAGE_HAVEGED=y
BR2_PACKAGE_DROPBEAR=y
BR2_PACKAGE_DROPBEAR_DISABLE_REVERSEDNS=y
BR2_PACKAGE_IFPLUGD=y
BR2_PACKAGE_SWUPDATE=y
BR2_PACKAGE_NANO=y
BR2_TARGET_UBOOT=y
BR2_TARGET_UBOOT_BUILD_SYSTEM_KCONFIG=y
BR2_TARGET_UBOOT_CUSTOM_GIT=y
BR2_TARGET_UBOOT_CUSTOM_REPO_URL="git://git.toradex.com/u-boot-toradex.git"
BR2_TARGET_UBOOT_CUSTOM_REPO_VERSION="2016.11-toradex"
BR2_TARGET_UBOOT_BOARD_DEFCONFIG="colibri_imx7"
BR2_TARGET_UBOOT_NEEDS_DTC=y
# BR2_TARGET_UBOOT_FORMAT_BIN is not set
BR2_TARGET_UBOOT_FORMAT_CUSTOM=y
BR2_TARGET_UBOOT_FORMAT_CUSTOM_NAME="u-boot-nand.imx"
BR2_PACKAGE_HOST_MTD=y
```

## colibri/package/mypackage/Config.in
```kconfig
config BR2_PACKAGE_MYPACKAGE
    bool "mypackage"
    help
      This is a comment that explains what mypackage is. The help text
      should be wrapped.  
      
```
